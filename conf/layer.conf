## conf/layer.conf
```bitbake
# We have a conf and classes directory, append to BBPATH
BBPATH .= ":${LAYERDIR}"

# We have a recipes directory, add to BBFILES
BBFILES += "${LAYERDIR}/recipes-*/*.bb ${LAYERDIR}/recipes-*/*.bbappend \
            ${LAYERDIR}/recipes-*/*/*.bb ${LAYERDIR}/recipes-*/*/*.bbappend \
            ${LAYERDIR}/recipes-*/*/*/*.bb ${LAYERDIR}/recipes-*/*/*/*.bbappend"

LOCALE_GENERATION_WITH_CROSS-LOCALEDEF_forcevariable = "0"

BBFILE_COLLECTIONS += "fortis-layer"
BBFILE_PATTERN_fortis-layer := "^${LAYERDIR}/"
BBFILE_PRIORITY_fortis-layer = "7"

PREFERRED_VERSION_libnl ?= "3.2.29"
PREFERRED_VERSION_libarchive ?= "3.2.2"
PREFERRED_VERSION_libarchive-native ?= "3.2.2"
```

## conf/machine/hs7810a.conf
```bitbake
require conf/machine/include/hs7xx0.inc
require conf/machine/include/smallflash.inc

MACHINE_FEATURES += "hs7810a"
```
